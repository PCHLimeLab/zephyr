## boards/arm/nucleo_l010rb/Kconfig.board
```kconfig
# STM32 Nucleo-64 development board with STM32L010RB MCU configuration

# Copyright (c) 2018 Ilya Tagunov <tagunil@gmail.com>
# SPDX-License-Identifier: Apache-2.0

config BOARD_NUCLEO_L010RB
	bool "NUCLEO-64 L010RB Development Board"
	depends on SOC_STM32L010XB
```

## soc/arm/st_stm32/stm32l0/Kconfig.defconfig.stm32l010xb
```kconfig
# ST Microelectronics STM32L010XB MCU
#
# Copyright (c) 2019-2020 Grinn
# SPDX-License-Identifier: Apache-2.0

if SOC_STM32L010XB

config SOC
	default "stm32l010xb"

config NUM_IRQS
	default 32

endif # SOC_STM32L010XB
```
